// SPDX-License-Identifier: (GPL-2.0+ OR MIT)
/*
 * Copyright 2019 NXP
 * Copyright 2024 Koan Software
 */

/dts-v1/;

#include "imx8mp-astrial-base.dtsi"

&iomuxc {
	pinctrl-0 = <
		&pinctrl_hog
		&pinctrl_gpio_flexcan2
		&pinctrl_gpio_spi2
		&pinctrl_gpio_sdhc1
	>;
};

&uart3 {
    status = "okay";
};
